/**
 * @file    enr312_stepgen.c
 * @brief   One TIM2 update event -> one STCK rising edge -> one microstep.
 */

#include "enr312_board.h"
#include "enr312_stepgen.h"
#include "enr312_safety.h"

static volatile uint32_t s_remaining = 0;
static volatile uint64_t s_total     = 0;
static volatile int32_t  s_pos       = 0;     /* signed, DIR-pin sense   */
static volatile int32_t  s_dir       = 1;
static volatile bool     s_vel_mode  = false;

/* Step timer tick: 84 MHz APB1 timer clock / prescaler = 82031.25 Hz. */
#define STEP_TICK_HZ   (84000000.0 / (double)ENR312_STEP_TIM_PSC)
#define STEP_MIN_RATE  2.0

void ENR312_StepGen_Init(void)
{
    __HAL_RCC_TIM2_CLK_ENABLE();
    ENR312_STEP_TIM->CR1  = 0;                            /* stopped */
    ENR312_STEP_TIM->PSC  = ENR312_STEP_TIM_PSC - 1u;     /* 82031.25 Hz tick */
    ENR312_STEP_TIM->ARR  = 0xFFFFu;
    ENR312_STEP_TIM->CNT  = 0;
    ENR312_STEP_TIM->DIER = TIM_DIER_UIE;
    ENR312_STEP_TIM->SR   = 0;

    /* Above the control loop (6), below the L6474 FLAG fault input (2). A late
     * step pulse is a rate error; a late fault response is a burnt driver. */
    HAL_NVIC_SetPriority(ENR312_STEP_TIM_IRQn, 4, 0);
    HAL_NVIC_EnableIRQ(ENR312_STEP_TIM_IRQn);

    HAL_GPIO_WritePin(ENR312_STCK_PORT, ENR312_STCK_PIN, GPIO_PIN_RESET);
}

bool ENR312_StepGen_Start(ENR312_StepDir_t dir, uint32_t count, uint32_t arr)
{
    if (!ENR312_Safety_MotionPermitted()) {
        return false;
    }
    if (count == 0u || arr == 0u || s_remaining != 0u) {
        return false;
    }

    /* DIR is sampled by the L6474 on the STCK rising edge. Set it and let it
     * settle before the first pulse -- the datasheet setup time is nanoseconds,
     * but the pulse is a whole timer period away, so this is free. */
    HAL_GPIO_WritePin(ENR312_DIR_PORT, ENR312_DIR_PIN,
                      (dir == ENR312_STEP_DIR_POSITIVE) ? GPIO_PIN_SET : GPIO_PIN_RESET);
    s_dir = (dir == ENR312_STEP_DIR_POSITIVE) ? 1 : -1;
    s_vel_mode = false;

    s_remaining = count;

    ENR312_STEP_TIM->ARR = arr;
    ENR312_STEP_TIM->CNT = 0;
    ENR312_STEP_TIM->SR  = 0;
    ENR312_STEP_TIM->CR1 = TIM_CR1_CEN;
    return true;
}

void ENR312_StepGen_Stop(void)
{
    ENR312_STEP_TIM->CR1 = 0;
    ENR312_STEP_TIM->SR  = 0;
    s_remaining = 0;
    s_vel_mode = false;
    HAL_GPIO_WritePin(ENR312_STCK_PORT, ENR312_STCK_PIN, GPIO_PIN_RESET);
}

uint32_t ENR312_StepGen_Remaining(void)  { return s_remaining; }
bool     ENR312_StepGen_Busy(void)       { return s_remaining != 0u; }
uint64_t ENR312_StepGen_TotalPulses(void){ return s_total; }

/**
 * @brief TIM2 update: emit one pulse, decrement, stop when the budget is spent.
 *
 * The pulse is generated by BSRR set/reset with a short calibrated spin rather
 * than a second timer channel. PC7 has no TIM2 alternate function on this part
 * (see enr312_board.h), so a software pulse is the only option; the spin is
 * ~1 us against a minimum step period of ~12 us, and it is bounded, so it
 * cannot become a hang.
 */
void ENR312_StepGen_IrqHandler(void)
{
    if ((ENR312_STEP_TIM->SR & TIM_SR_UIF) == 0u) {
        return;
    }
    ENR312_STEP_TIM->SR = (uint16_t)~TIM_SR_UIF;

    if (!ENR312_Safety_MotionPermitted() || (!s_vel_mode && s_remaining == 0u)) {
        ENR312_StepGen_Stop();
        return;
    }

    ENR312_STCK_PORT->BSRR = ENR312_STCK_PIN;                    /* rising edge */
    for (volatile uint32_t i = 0; i < ENR312_STCK_PULSE_CYCLES / 3u; i++) { }
    ENR312_STCK_PORT->BSRR = (uint32_t)ENR312_STCK_PIN << 16u;   /* falling     */

    s_total++;
    s_pos += s_dir;
    if (!s_vel_mode && --s_remaining == 0u) {
        ENR312_STEP_TIM->CR1 = 0;
    }
}

bool ENR312_StepGen_SetVelocity(double usteps_per_s)
{
    if (!ENR312_Safety_MotionPermitted()) {
        ENR312_StepGen_Stop();
        return false;
    }
    if (s_remaining != 0u) {
        return false;                         /* a counted move owns the timer */
    }
    s_vel_mode = true;
    double a = (usteps_per_s >= 0.0) ? usteps_per_s : -usteps_per_s;
    if (a < STEP_MIN_RATE) {
        ENR312_STEP_TIM->CR1 = 0;             /* rest; stay in velocity mode   */
        return true;
    }
    double arr_d = STEP_TICK_HZ / a + 0.5;
    uint32_t arr = (arr_d > 65535.0) ? 65535u : (uint32_t)arr_d;
    if (arr < 2u) { arr = 2u; }

    int32_t dir = (usteps_per_s >= 0.0) ? 1 : -1;
    if (dir != s_dir) {
        HAL_GPIO_WritePin(ENR312_DIR_PORT, ENR312_DIR_PIN,
                          (dir > 0) ? GPIO_PIN_SET : GPIO_PIN_RESET);
        s_dir = dir;
    }
    if ((ENR312_STEP_TIM->CR1 & TIM_CR1_CEN) == 0u) {
        ENR312_STEP_TIM->CNT = 0;
        ENR312_STEP_TIM->ARR = arr;
        ENR312_STEP_TIM->SR  = 0;
        ENR312_STEP_TIM->CR1 = TIM_CR1_CEN;
    } else {
        /* No ARR preload: a new period shorter than the count already elapsed
         * would otherwise run the counter round to 0xFFFF (0.8 s with no
         * pulses). Restart the period instead; costs at most one period. */
        if (ENR312_STEP_TIM->CNT + 2u >= arr) {
            ENR312_STEP_TIM->CNT = 0;
        }
        ENR312_STEP_TIM->ARR = arr;
    }
    return true;
}

int32_t ENR312_StepGen_Position(void) { return s_pos; }
void    ENR312_StepGen_SetOrigin(void) { s_pos = 0; }
